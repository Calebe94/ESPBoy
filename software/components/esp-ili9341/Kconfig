## software/components/esp-ili9341/Kconfig
```kconfig
menu "ILI9341 configuration"

config SPI_CLOCK_SPEED_HZ
    int "SPI clock speed in Hz"
    default 48000000
    range 0 60000000
    help
        SPI clock speed in Hz. If you have problems try a lower value.

config ILI9341_PIN_MISO
    int "MISO pin number"
    default 19
    help
        MISO pin number. Defaults are ok for M5Stack.

config ILI9341_PIN_MOSI
    int "MOSI pin number"
    default 23
    help
        MOSI pin number. Defaults are ok for M5Stack.

config ILI9341_PIN_CLK
    int "CLK pin number"
    default 18
    help
        CLK pin number. Defaults are ok for M5Stack.

config ILI9341_PIN_CS
    int "CS pin number"
    default 14
    help
        CS pin number. Defaults are ok for M5Stack.

config ILI9341_PIN_DC
    int "DC pin number"
    default 27
    help
        DC pin number. Defaults are ok for M5Stack.


config ILI9341_PIN_RST
    int "RST pin number"
    default 33
    help
        RST pin number. Defaults are ok for M5Stack.

config ILI9341_PIN_BCKL
    int "Backlight pin number"
    default 32
    help
        Backlight pin number. Defaults are ok for M5Stack.

endmenu
```
